## config/west.yml
```yaml
manifest:
  remotes:
    - name: zmkfirmware
      url-base: https://github.com/zmkfirmware
    - name: mctechnology17
      url-base: https://github.com/mctechnology17
    - name: cormoran
      url-base: https://github.com/cormoran
  projects:
    - name: zmk
      remote: cormoran
      revision: main+dya
      import: app/west.yml
    - name: zmk-behavior-runtime-sensor-rotate
      remote: cormoran
      revision: main
    - name: zmk-module-ble-management
      remote: cormoran
      revision: main
    - name: zmk-module-battery-history
      remote: cormoran
      revision: main
    - name: zmk-module-settings-rpc
      remote: cormoran
      revision: main
    - name: zmk-module-runtime-input-processor
      remote: cormoran
      revision: main

    # dya studio stuff
    - name: zmk-feature-device-info
      remote: cormoran
      revision: main
    - name: zmk-feature-watchdog
      remote: cormoran
      revision: main
    - name: zmk-feature-kscan-diagnostics
      remote: cormoran
      revision: main
    - name: zmk-module-devtool
      remote: cormoran
      revision: main
  self:
    path: config
```
