## boards/shields/nice_oled/Kconfig.defconfig
```kconfig
if SHIELD_NICE_OLED || SHIELD_NICE_EPAPER || SHIELD_NICE_CUSTOM

config NICE_CUSTOM_ON
    bool "Enable nice custom widget compatibility"
    default n

config NICE_OLED_ON
    bool "Enable nice oled widget compatibility"
    default y

config NICE_EPAPER_ON
    bool "Enable nice view widget compatibility"
    default n

config NICE_OLED_CUSTOM_CANVAS_WIDTH
    int "Custom Canvas Width"
    default 68

config NICE_OLED_CUSTOM_CANVAS_HEIGHT
    int "Custom Canvas Height"
    default 160

config LV_Z_VDB_SIZE
    default 64 if NICE_OLED_ON
    default 100 if NICE_EPAPER_ON
    default 100 if NICE_CUSTOM_ON

config LV_DPI_DEF
    default 148 if NICE_OLED_ON
    default 161 if NICE_EPAPER_ON
    default 161 if NICE_CUSTOM_ON

config LV_Z_BITS_PER_PIXEL
    default 1

choice LV_COLOR_DEPTH
    default LV_COLOR_DEPTH_1
endchoice

choice ZMK_DISPLAY_WORK_QUEUE
    default ZMK_DISPLAY_WORK_QUEUE_DEDICATED
endchoice

choice ZMK_DISPLAY_STATUS_SCREEN
    default ZMK_DISPLAY_STATUS_SCREEN_CUSTOM
endchoice

config ZMK_DISPLAY_BLANK_ON_IDLE
    default n if NICE_OLED_ON
    default y if NICE_EPAPER_ON
    default y if NICE_CUSTOM_ON

config LV_Z_MEM_POOL_SIZE
    default 16384

config ZMK_DISPLAY_DEDICATED_THREAD_STACK_SIZE
    int "zmk display dedicated thread stack size"
    default 8192

config ZMK_DISPLAY_DEDICATED_THREAD_PRIORITY
    int "zmk display dedicated thread priority"
    default 5

config ZMK_DISPLAY_STATUS_SCREEN_CUSTOM
    imply NICE_OLED_WIDGET_STATUS

config NICE_OLED_WIDGET_STATUS
    bool "Custom nice oled status widget"
    default y
    select LV_USE_LABEL
    select LV_USE_IMAGE
    select LV_USE_CANVAS
    select LV_USE_ANIMIMG
    select LV_USE_ANIMATION

config NICE_OLED_WIDGET_INVERTED
    bool "Invert display colors"

config NICE_OLED_WIDGET_OUTPUT_BACKGROUND
    bool "Enable output background on central and peripheral"
    default n if NICE_OLED_ON
    default y if NICE_EPAPER_ON
    default y if NICE_CUSTOM_ON

config NICE_OLED_SHOW_SLEEP_ART_ON_IDLE
    bool "whether the sleep art should be shown on idle"
    default n

config NICE_OLED_SHOW_SLEEP_ART_ON_SLEEP
    bool "whether the sleep art should be shown on idle"
    default n

config NICE_OLED_SLEEP_STATUS_BOOTLOADER
    bool "Show bootloader image briefly on wake (sleep status variant)"
    default n

config NICE_OLED_WIDGET_ANIMATION_PERIPHERAL_SMART_BATTERY
    bool "Enable animation on peripheral"
    default n

config NICE_OLED_WIDGET_ANIMATION_PERIPHERAL_WPM
    bool "Enable PERIPHERAL WPM widget compatibility"
    default n

if NICE_OLED_WIDGET_ANIMATION_PERIPHERAL_WPM

config NICE_OLED_WIDGET_STATUS
    select ZMK_WPM

endif

config NICE_OLED_WIDGET_ANIMATION_PERIPHERAL
    bool "Enable animation on peripheral"
    default y

config NICE_OLED_WIDGET_STATIC_IMAGE_PERIPHERAL
    bool "Enable static image on peripheral"
    default y if !NICE_OLED_WIDGET_ANIMATION_PERIPHERAL

if NICE_OLED_WIDGET_ANIMATION_PERIPHERAL || NICE_OLED_WIDGET_STATIC_IMAGE_PERIPHERAL

if NICE_OLED_WIDGET_ANIMATION_PERIPHERAL

choice NICE_OLED_WIDGET_ANIMATION_PERIPHERAL_CHOICE
    prompt "Peripheral Animation"
    default NICE_OLED_WIDGET_ANIMATION_PERIPHERAL_POKEMON

config NICE_OLED_WIDGET_ANIMATION_PERIPHERAL_GEM
    bool "Enable gem animation on peripheral"

config NICE_OLED_WIDGET_ANIMATION_PERIPHERAL_CAT
    bool "Enable cat animation on peripheral"

config NICE_OLED_WIDGET_ANIMATION_PERIPHERAL_HEAD
    bool "Enable head animation on peripheral"

config NICE_OLED_WIDGET_ANIMATION_PERIPHERAL_POKEMON
    bool "Enable pokemon animation on peripheral"

config NICE_OLED_WIDGET_ANIMATION_PERIPHERAL_SPACEMAN
    bool "Enable spaceman animation on peripheral"

endchoice

config NICE_OLED_WIDGET_ANIMATION_PERIPHERAL_MS
    int "Animation length in milliseconds"
    default 10000 if NICE_OLED_WIDGET_ANIMATION_PERIPHERAL_POKEMON
    default 4800 if NICE_OLED_WIDGET_ANIMATION_PERIPHERAL_HEAD
    default 4800 if NICE_OLED_WIDGET_ANIMATION_PERIPHERAL_SPACEMAN
    default 960 if NICE_OLED_WIDGET_ANIMATION_PERIPHERAL_GEM
    default 960 if NICE_OLED_WIDGET_ANIMATION_PERIPHERAL_CAT

endif

if NICE_OLED_WIDGET_STATIC_IMAGE_PERIPHERAL

choice NICE_OLED_WIDGET_STATIC_IMAGE_PERIPHERAL_CHOICE
    prompt "Peripheral Static Image"
    default NICE_OLED_WIDGET_STATIC_IMAGE_PERIPHERAL_VIM

config NICE_OLED_WIDGET_STATIC_IMAGE_PERIPHERAL_VIM
    bool "Enable static vim on peripheral"

config NICE_OLED_WIDGET_STATIC_IMAGE_PERIPHERAL_SPACEMAN
    bool "Enable static spaceman frame on peripheral"

config NICE_OLED_WIDGET_STATIC_IMAGE_PERIPHERAL_VIP_MARCOS
    bool "Enable static vim_marcos on peripheral"

endchoice

endif

endif

config NICE_OLED_WIDGET_PERIPHERAL
    bool "Enable test widget on peripheral"
    default n

if !ZMK_SPLIT || ZMK_SPLIT_ROLE_CENTRAL

config NICE_OLED_WIDGET_WPM
    bool "Enable Nice OLED WPM Widget"
    default y

if NICE_OLED_WIDGET_WPM

config NICE_OLED_WIDGET_STATUS
    select ZMK_WPM

config NICE_OLED_WIDGET_WPM_NUMBER
    bool "Enable NUMBER for WPM"
    default n

config NICE_OLED_WIDGET_WPM_SPEEDOMETER
    bool "Enable SPEEDOMETER for WPM"
    default n if NICE_OLED_ON
    default n if NICE_EPAPER_ON
    default n if NICE_CUSTOM_ON

config NICE_OLED_WIDGET_WPM_GRAPH
    bool "Enable GRAPH for WPM gauge/chart"
    default n if NICE_OLED_ON
    default n if NICE_EPAPER_ON
    default n if NICE_CUSTOM_ON

if NICE_OLED_WIDGET_WPM_GRAPH || NICE_OLED_WIDGET_WPM_SPEEDOMETER

config NICE_OLED_WIDGET_WPM_GRAPH_FIXED_RANGE
    bool "Enable fixed range for WPM gauge/chart"
    default y

config NICE_OLED_WIDGET_WPM_GRAPH_FIXED_RANGE_MAX
    int "Fixed range maximum for WPM gauge/chart"
    default 100

endif

config NICE_OLED_WIDGET_WPM_LUNA
    bool "Enable wpm luna"
    default n

if NICE_OLED_WIDGET_WPM_LUNA

config NICE_OLED_WIDGET_WPM_LUNA_ANIMATION_MS
    int "Luna Animation in ms for WPM Widget"
    default 300

endif

config NICE_OLED_WIDGET_WPM_BONGO_CAT
    bool "Enable wpm bongo cat"
    default y

if NICE_OLED_WIDGET_WPM_BONGO_CAT

config NICE_OLED_WIDGET_BONGO_CAT_ANIMATION_MS
    int "Bongo Cat Animation in ms for WPM Widget"
    default 300

endif
endif

config NICE_OLED_WIDGET_RESPONSIVE
    bool "Enable widget responsive"
    default n

if NICE_OLED_WIDGET_RESPONSIVE

config ZMK_DISPLAY_DEDICATED_THREAD_STACK_SIZE
    default 8192

config ZMK_DISPLAY_DEDICATED_THREAD_PRIORITY
    default 3

config NICE_OLED_WIDGET_RESPONSIVE_BONGO_CAT
    bool "Enable widget responsive bongo cat"
    default n

if NICE_OLED_WIDGET_RESPONSIVE_BONGO_CAT

endif
endif

config NICE_OLED_WIDGET_HID_INDICATORS
    bool "Enable HID indicators"
    default y

if NICE_OLED_WIDGET_HID_INDICATORS

config ZMK_HID_INDICATORS
    bool "Enable HID indicators"
    default y

config NICE_OLED_WIDGET_HID_INDICATORS_LUNA
    bool "Enable HID indicators luna"
    default n

if NICE_OLED_WIDGET_HID_INDICATORS_LUNA

config NICE_OLED_WIDGET_HID_INDICATORS_LUNA_ONLY_CAPSLOCK
    bool "Enable HID indicators luna only on CapsLock"
    default y

config NICE_OLED_WIDGET_HID_INDICATORS_LUNA_ANIMATION_MS
    int "Luna Animation in ms for HID Indicators"
    default 300

endif

config NICE_OLED_WIDGET_HID_INDICATORS_BONGO_CAT
    bool "Enable HID indicators bongo cat"
    default n

if NICE_OLED_WIDGET_HID_INDICATORS_BONGO_CAT

config NICE_OLED_WIDGET_HID_INDICATORS_BONGO_CAT_ONLY_CAPSLOCK
    bool "Enable HID indicators bongo cat only on CapsLock"
    default y

config NICE_OLED_WIDGET_HID_INDICATORS_BONGO_CAT_ANIMATION_MS
    int "Luna Animation in ms for HID Indicators bongo cat"
    default 300

endif

endif

config NICE_OLED_WIDGET_RAW_HID
    bool "Enable RAW HID"

if NICE_OLED_WIDGET_RAW_HID

config NICE_OLED_WIDGET_RAW_HID_DRIVER
    bool "Enable Raw HID"
    select LV_FONT_MONTSERRAT_14
    imply USB_DEVICE_HID
    default y if NICE_OLED_WIDGET_RAW_HID

config USB_HID_DEVICE_COUNT
    default 2

config NICE_OLED_WIDGET_RAW_HID_USAGE_PAGE
    hex "Raw HID Usage Page"
    default 0xFF60

config NICE_OLED_WIDGET_RAW_HID_USAGE
    hex "Raw HID Usage"
    default 0x61

config NICE_OLED_WIDGET_RAW_HID_REPORT_SIZE
    int "Raw HID Report Size"
    default 32

config NICE_OLED_WIDGET_RAW_HID_DEVICE
    string "Raw HID Device"
    default HID_1

config NICE_OLED_WIDGET_RAW_HID_LAYOUT
    bool "Show layout"
    default y

config NICE_OLED_WIDGET_RAW_HID_TIME
    bool "Show time"
    default y

config NICE_OLED_WIDGET_RAW_HID_VOLUME
    bool "Show volume"
    default y

config NICE_OLED_WIDGET_RAW_HID_LAYOUT_LIST
    string "Comma-separated layout list"
    default "DE,US,LA,AB"

config NICE_OLED_WIDGET_RAW_HID_WEATHER
    bool "nice!OLED Weather Widget"
    default n

config NICE_OLED_WIDGET_RAW_HID_MEDIA_PLAYER_SPOTIFY_MACOS
    bool "nice!OLED Spotify MacOS Media Player Widget"
    default n

endif

config NICE_OLED_WIDGET_MODIFIERS_INDICATORS
    bool "Enable modifiers indicators"
    default y

if NICE_OLED_WIDGET_MODIFIERS_INDICATORS

config NICE_OLED_WIDGET_MODIFIERS_INDICATORS_FIXED
    bool "Enable modifiers indicators fixed"
    default y

if NICE_OLED_WIDGET_MODIFIERS_INDICATORS_FIXED

choice NICE_OLED_WIDGET_MODIFIERS_INDICATORS_FIXED_STYLE
    prompt "Modifiers Style"
    default NICE_OLED_WIDGET_MODIFIERS_INDICATORS_FIXED_SYMBOL

    config NICE_OLED_WIDGET_MODIFIERS_INDICATORS_FIXED_LETTER
        bool "Letter (e.g. C S A G)"

    config NICE_OLED_WIDGET_MODIFIERS_INDICATORS_FIXED_SYMBOL
        bool "Symbol (Icons)"
endchoice

choice NICE_OLED_WIDGET_MODIFIERS_INDICATORS_FIXED_LAYOUT
    prompt "Modifiers Layout"
    default NICE_OLED_WIDGET_MODIFIERS_INDICATORS_FIXED_BOX

    config NICE_OLED_WIDGET_MODIFIERS_INDICATORS_FIXED_HOR
        bool "Horizontal (One Line)"

    config NICE_OLED_WIDGET_MODIFIERS_INDICATORS_FIXED_VER
        bool "Vertical (Stacked)"

    config NICE_OLED_WIDGET_MODIFIERS_INDICATORS_FIXED_BOX
        bool "Box (2x2 Grid)"
endchoice

if NICE_OLED_WIDGET_MODIFIERS_INDICATORS_FIXED_VER

choice NICE_OLED_WIDGET_MODIFIERS_INDICATORS_FIXED_VER_ALIGN
    prompt "Vertical Layout Alignment"
    default NICE_OLED_WIDGET_MODIFIERS_INDICATORS_FIXED_VER_ALIGN_CENTER

    config NICE_OLED_WIDGET_MODIFIERS_INDICATORS_FIXED_VER_ALIGN_LEFT
        bool "Left"

    config NICE_OLED_WIDGET_MODIFIERS_INDICATORS_FIXED_VER_ALIGN_CENTER
        bool "Center"

    config NICE_OLED_WIDGET_MODIFIERS_INDICATORS_FIXED_VER_ALIGN_RIGHT
        bool "Right"
endchoice

endif

choice NICE_OLED_WIDGET_MODIFIERS_INDICATORS_FIXED_SYMBOL_OS
    prompt "Symbol OS Style"
    default NICE_OLED_WIDGET_MODIFIERS_INDICATORS_FIXED_SYMBOL_MACOS
    depends on NICE_OLED_WIDGET_MODIFIERS_INDICATORS_FIXED_SYMBOL

    config NICE_OLED_WIDGET_MODIFIERS_INDICATORS_FIXED_SYMBOL_MACOS
        bool "macOS (Cmd/Opt symbols)"

    config NICE_OLED_WIDGET_MODIFIERS_INDICATORS_FIXED_SYMBOL_WINDOWS
        bool "Windows (Win/Alt symbols)"
endchoice

endif

config NICE_OLED_WIDGET_MODIFIERS_INDICATORS_LUNA
    bool "Enable modifiers indicators luna"
    default n

if NICE_OLED_WIDGET_MODIFIERS_INDICATORS_LUNA

config NICE_OLED_WIDGET_MODIFIERS_INDICATORS_LUNA_ANIMATION_MS
    int "Luna Animation in ms for Modifiers Indicators"
    default 300

endif

config NICE_OLED_WIDGET_MODIFIERS_INDICATORS_BONGO_CAT
    bool "Enable modifiers indicators bongo cat"
    default n

if NICE_OLED_WIDGET_MODIFIERS_INDICATORS_BONGO_CAT

config NICE_OLED_WIDGET_MODIFIERS_INDICATORS_BONGO_CAT_ANIMATION_MS
    int "Bongo Cat Animation in ms for Modifiers Indicators"
    default 300

endif

endif

config NICE_OLED_WIDGET_LAYER
    bool "Enable layer widget"
    default y

config NICE_OLED_WIDGET_PROFILE_BIG
    bool "Enable show widget profile bigger"
    default y if NICE_EPAPER_ON
    default y if NICE_CUSTOM_ON
    default n

config NICE_OLED_WIDGET_CENTRAL_SHOW_BATTERY_PERIPHERAL_ALL
    bool "View all available batteries on the central screen, including the central battery."
    default n

config NICE_OLED_WIDGET_CENTRAL_SHOW_BATTERY_PERIPHERAL_ONLY
    bool "View all peripheral batteries, but not the central battery"
    default n

config NICE_OLED_WIDGET_CENTRAL_SHOW_BATTERY_PERIPHERAL_AND_CENTRAL
    bool "View only 1 peripheral batterie and the central battery"
    default n

config NICE_OLED_WIDGET_CENTRAL
    bool "Enable test widget on central"
    default n

endif

config NICE_OLED_WIDGET_LAYER_CUSTOM_X
    int "Layer widget X position"
    default 0 if NICE_OLED_ON
    default 0 if NICE_EPAPER_ON
    default 0

config NICE_OLED_WIDGET_LAYER_CUSTOM_Y
    int "Layer widget Y position"
    default 146 if NICE_OLED_ON
    default 146 if NICE_EPAPER_ON
    default 146

config NICE_OLED_WIDGET_BATTERY_CUSTOM_X
    int "Battery widget X position"
    default 0 if NICE_OLED_ON
    default 26 if NICE_EPAPER_ON
    default 0

config NICE_OLED_WIDGET_BATTERY_CUSTOM_Y
    int "Battery widget Y position"
    default 50 if NICE_OLED_ON
    default 19 if NICE_EPAPER_ON
    default 50

config NICE_OLED_WIDGET_PROFILE_CUSTOM_X
    int "Profile widget X position"
    default 0 if NICE_OLED_ON
    default 18 if NICE_EPAPER_ON
    default 0

config NICE_OLED_WIDGET_PROFILE_CUSTOM_Y
    int "Profile widget Y position"
    default 137 if NICE_OLED_ON
    default 129 if NICE_EPAPER_ON
    default 137

config NICE_OLED_WIDGET_PROFILE_TEXT_CUSTOM_X
    int "Profile text X position"
    default 25 if NICE_OLED_ON
    default 25 if NICE_EPAPER_ON
    default 25

config NICE_OLED_WIDGET_PROFILE_TEXT_CUSTOM_Y
    int "Profile text Y position"
    default 32 if NICE_OLED_ON
    default 32 if NICE_EPAPER_ON
    default 32

config NICE_OLED_WIDGET_OUTPUT_USB_CUSTOM_X
    int "Output USB icon X position"
    default 0 if NICE_OLED_ON
    default 45 if NICE_EPAPER_ON
    default 0

config NICE_OLED_WIDGET_OUTPUT_USB_CUSTOM_Y
    int "Output USB icon Y position"
    default 34 if NICE_OLED_ON
    default 2 if NICE_EPAPER_ON
    default 34

config NICE_OLED_WIDGET_OUTPUT_BT_CUSTOM_X
    int "Output BT icon X position"
    default 4 if NICE_OLED_ON
    default 49 if NICE_EPAPER_ON
    default 4

config NICE_OLED_WIDGET_OUTPUT_BT_CUSTOM_Y
    int "Output BT icon Y position"
    default 32 if NICE_OLED_ON
    default 0 if NICE_EPAPER_ON
    default 32

config NICE_OLED_WIDGET_OUTPUT_BT_UNBONDED_CUSTOM_X
    int "Output BT unbonded icon X position"
    default -1 if NICE_OLED_ON
    default 44 if NICE_EPAPER_ON
    default -1

config NICE_OLED_WIDGET_OUTPUT_BT_UNBONDED_CUSTOM_Y
    int "Output BT unbonded icon Y position"
    default 32 if NICE_OLED_ON
    default 0 if NICE_EPAPER_ON
    default 32

config NICE_OLED_WIDGET_WPM_GAUGE_CUSTOM_X
    int "WPM gauge X position"
    default 0 if NICE_OLED_ON
    default 16 if NICE_EPAPER_ON
    default 0

config NICE_OLED_WIDGET_WPM_GAUGE_CUSTOM_Y
    int "WPM gauge Y position"
    default 70 if NICE_OLED_ON
    default 43 if NICE_EPAPER_ON
    default 70

config NICE_OLED_WIDGET_WPM_NEEDLE_CENTER_CUSTOM_X
    int "WPM needle center X position"
    default 12 if NICE_OLED_ON
    default 33 if NICE_EPAPER_ON
    default 12

config NICE_OLED_WIDGET_WPM_NEEDLE_CENTER_CUSTOM_Y
    int "WPM needle center Y position"
    default 90 if NICE_OLED_ON
    default 66 if NICE_EPAPER_ON
    default 90

config NICE_OLED_WIDGET_WPM_LABEL_CUSTOM_X
    int "WPM label X position"
    default 0 if NICE_OLED_ON
    default 0 if NICE_EPAPER_ON
    default 0

config NICE_OLED_WIDGET_WPM_LABEL_CUSTOM_Y
    int "WPM label Y position"
    default 75 if NICE_OLED_ON
    default 103 if NICE_EPAPER_ON
    default 75

config NICE_OLED_WIDGET_LUNA_CUSTOM_X
    int "Luna widget X position"
    default 65 if NICE_OLED_ON
    default 100 if NICE_EPAPER_ON
    default 100

config NICE_OLED_WIDGET_LUNA_CUSTOM_Y
    int "Luna widget Y position"
    default 0 if NICE_OLED_ON
    default 15 if NICE_EPAPER_ON
    default 0

config NICE_OLED_WIDGET_BONGO_CAT_CUSTOM_X
    int "Bongo cat widget X position"
    default 64 if NICE_OLED_ON
    default 100 if NICE_EPAPER_ON
    default 64

config NICE_OLED_WIDGET_BONGO_CAT_CUSTOM_Y
    int "Bongo cat widget Y position"
    default -9 if NICE_OLED_ON
    default 8 if NICE_EPAPER_ON
    default -9

config NICE_OLED_WIDGET_HID_INDICATORS_CUSTOM_X
    int "HID indicators widget X position"
    default 64 if NICE_OLED_ON && NICE_OLED_WIDGET_HID_INDICATORS_BONGO_CAT
    default 36 if NICE_OLED_ON
    default 100 if NICE_EPAPER_ON
    default 36

config NICE_OLED_WIDGET_HID_INDICATORS_CUSTOM_Y
    int "HID indicators widget Y position"
    default -9 if NICE_OLED_ON && NICE_OLED_WIDGET_HID_INDICATORS_BONGO_CAT
    default 0 if NICE_OLED_ON
    default 15 if NICE_EPAPER_ON && !NICE_OLED_WIDGET_HID_INDICATORS_BONGO_CAT
    default 8 if NICE_EPAPER_ON
    default 0

config NICE_OLED_WIDGET_MODIFIERS_CUSTOM_X
    int "Modifiers widget X position"
    default 0 if NICE_OLED_ON
    default 62 if NICE_EPAPER_ON
    default 62

config NICE_OLED_WIDGET_MODIFIERS_CUSTOM_Y
    int "Modifiers widget Y position"
    default 100 if NICE_OLED_ON
    default 62 if NICE_EPAPER_ON
    default 100

config NICE_OLED_WIDGET_ANIMATION_PERIPHERAL_CUSTOM_X
    int "Animation peripheral X position"
    default 18 if NICE_OLED_ON
    default 36 if NICE_EPAPER_ON
    default 18

config NICE_OLED_WIDGET_ANIMATION_PERIPHERAL_CUSTOM_Y
    int "Animation peripheral Y position"
    default -18 if NICE_OLED_ON
    default 0 if NICE_EPAPER_ON
    default -18

config NICE_OLED_WIDGET_RAW_HID_CUSTOM_X
    int "Raw HID base X position"
    default 0 if NICE_OLED_ON
    default 0 if NICE_EPAPER_ON
    default 0

config NICE_OLED_WIDGET_RAW_HID_CUSTOM_Y
    int "Raw HID base Y position"
    default 62 if NICE_OLED_ON
    default 62 if NICE_EPAPER_ON
    default 62

config NICE_OLED_WIDGET_RAW_HID_WEATHER_CUSTOM_X
    int "Raw HID Weather X position"
    default 0 if NICE_OLED_ON
    default 0 if NICE_EPAPER_ON
    default 0

config NICE_OLED_WIDGET_RAW_HID_WEATHER_CUSTOM_Y
    int "Raw HID Weather Y position"
    default 62 if NICE_OLED_ON
    default 62 if NICE_EPAPER_ON
    default 62

config NICE_OLED_WIDGET_RAW_HID_TIME_CUSTOM_X
    int "Raw HID Time X position"
    default 0 if NICE_OLED_ON
    default 0 if NICE_EPAPER_ON
    default 0

config NICE_OLED_WIDGET_RAW_HID_TIME_CUSTOM_Y
    int "Raw HID Time Y position"
    default 74 if NICE_OLED_ON
    default 74 if NICE_EPAPER_ON
    default 74

config NICE_OLED_WIDGET_RAW_HID_LAYOUT_CUSTOM_X
    int "Raw HID Layout X position"
    default 0 if NICE_OLED_ON
    default 0 if NICE_EPAPER_ON
    default 0

config NICE_OLED_WIDGET_RAW_HID_LAYOUT_CUSTOM_Y
    int "Raw HID Layout Y position"
    default 86 if NICE_OLED_ON
    default 86 if NICE_EPAPER_ON
    default 86

config NICE_OLED_WIDGET_RAW_HID_VOLUME_CUSTOM_X
    int "Raw HID Volume X position"
    default 0 if NICE_OLED_ON
    default 0 if NICE_EPAPER_ON
    default 0

config NICE_OLED_WIDGET_RAW_HID_VOLUME_CUSTOM_Y
    int "Raw HID Volume Y position"
    default 98 if NICE_OLED_ON
    default 98 if NICE_EPAPER_ON
    default 98

config NICE_OLED_WIDGET_RAW_HID_MEDIA_PLAYER_CUSTOM_X
    int "Raw HID Media Player X position"
    default 0 if NICE_OLED_ON
    default 0 if NICE_EPAPER_ON
    default 0

config NICE_OLED_WIDGET_RAW_HID_MEDIA_PLAYER_CUSTOM_Y
    int "Raw HID Media Player Y position"
    default 110 if NICE_OLED_ON
    default 110 if NICE_EPAPER_ON
    default 110

config NICE_OLED_WIDGET_RESPONSIVE_BONGO_CAT_CUSTOM_X
    int "Responsive bongo cat widget X position"
    default 64 if NICE_OLED_ON
    default 64 if NICE_EPAPER_ON
    default 64

config NICE_OLED_WIDGET_RESPONSIVE_BONGO_CAT_CUSTOM_Y
    int "Responsive bongo cat widget Y position"
    default -9 if NICE_OLED_ON
    default -9 if NICE_EPAPER_ON
    default -9

config NICE_OLED_WIDGET_SLEEP_STATUS_CUSTOM_X
    int "Sleep status widget X position"
    default 0 if NICE_OLED_ON
    default 0 if NICE_EPAPER_ON
    default 0

config NICE_OLED_WIDGET_SLEEP_STATUS_CUSTOM_Y
    int "Sleep status widget Y position"
    default 0 if NICE_OLED_ON
    default 0 if NICE_EPAPER_ON
    default 0

endif
```
